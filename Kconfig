## Kconfig
```kconfig
config ENV_GPIO_RANGE_MIN
    int
    default 0

config ENV_GPIO_RANGE_MAX
    int
    default 39


menu "Ethernet Kit configuration"

    menu "Ethernet Chip Type"
        choice ESP32_PHY_CHIP
            prompt "Ethernet chip type."
            default ESP32_PHY_IP101
            help 
                ETH chip used on the Billboard
            
            config ESP32_PHY_IP101
                bool "IP101 Series"
            config ESP32_PHY_RTL8201
                bool "RTL8201"
            config ESP32_PHY_LAN87XX
                bool "LAN87XX"
            config ESP32_PHY_DP83848
                bool "DP83848"
            config ESP32_PHY_KSZ80XX
                bool "KSZ80XX"
        endchoice
    endmenu

    menu "Ethernet Chip pinouts"
        config ETH_SPI_CS_PIN
            int "SPI CS GPIO number for SPI Ethernet module"
            range ENV_GPIO_RANGE_MIN ENV_GPIO_RANGE_MAX
            default 32 if IDF_TARGET_ESP32
            default 7 if IDF_TARGET_ESP32S2 || IDF_TARGET_ESP32S3
            default 8 if IDF_TARGET_ESP32C3
            help
                Set the GPIO number used by SPI CS1, i.e. Chip Select associated with the second SPI Eth module.

        config ETH_SPI_INT_PIN
            int "Interrupt GPIO number SPI Ethernet module"
            range ENV_GPIO_RANGE_MIN ENV_GPIO_RANGE_MAX
            default 4 if IDF_TARGET_ESP32 || IDF_TARGET_ESP32S2 || IDF_TARGET_ESP32C3 || IDF_TARGET_ESP32S3
            help
                Set the GPIO number used by the first SPI Ethernet module interrupt line.

        config ETH_SPI_RST_PIN
            int "PHY Reset GPIO number"
            range -1 ENV_GPIO_RANGE_MAX
            default 5
            help
                Set the GPIO number used to reset PHY chip.
                Set to -1 to disable PHY chip hardware reset.

        config ETH_SPI_MDC_PIN
            int "SMI MDC GPIO number"
            range ENV_GPIO_RANGE_MIN ENV_GPIO_RANGE_MAX
            default 23
            help
                Set the GPIO number used by SMI MDC.

        config ETH_SPI_MDIO_PIN
            int "SMI MDIO GPIO number"
            range ENV_GPIO_RANGE_MIN ENV_GPIO_RANGE_MAX
            default 18
            help
                Set the GPIO number used by SMI MDIO.

        config ETH_SPI_PHY_ADDR
            int "PHY Address"
            range 0 31
            default 1
            help
                Set PHY address according your board schematic.

        config ETH_SPI_HOST
            int "SPI Host Number"
            range 0 2
            default 1
            help
                Set the SPI host used to communicate with the SPI Ethernet Controller.

        config ETH_SPI_SCLK_PIN
            int "SPI SCLK GPIO number"
            range ENV_GPIO_RANGE_MIN ENV_GPIO_RANGE_MAX
            default 14 if IDF_TARGET_ESP32
            default 12 if IDF_TARGET_ESP32S2 || IDF_TARGET_ESP32S3
            default 6 if IDF_TARGET_ESP32C3
            help
                Set the GPIO number used by SPI SCLK.

        config ETH_SPI_MISO_PIN
            int "SPI MISO GPIO number"
            range ENV_GPIO_RANGE_MIN ENV_GPIO_RANGE_MAX
            default 12 if IDF_TARGET_ESP32
            default 13 if IDF_TARGET_ESP32S2 || IDF_TARGET_ESP32S3
            default 2 if IDF_TARGET_ESP32C3
            help
                Set the GPIO number used by SPI MISO.

        config ETH_SPI_MOSI_PIN
            int "SPI MOSI GPIO number"
            range ENV_GPIO_RANGE_MIN ENV_GPIO_RANGE_MAX
            default 13 if IDF_TARGET_ESP32
            default 11 if IDF_TARGET_ESP32S2 || IDF_TARGET_ESP32S3
            default 7 if IDF_TARGET_ESP32C3
            help
                Set the GPIO number used by SPI MOSI.

        config ETH_SPI_CLOCK_MHZ
            int "SPI clock speed (MHz)"
            range 5 80
            default 12 if IDF_TARGET_ESP32 || IDF_TARGET_ESP32C3
            default 36 if IDF_TARGET_ESP32S2 || IDF_TARGET_ESP32S3
            help
                Set the clock speed (MHz) of SPI interface.
    endmenu

endmenu
```
